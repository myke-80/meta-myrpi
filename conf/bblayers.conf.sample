## conf/bblayers.conf.sample
```bitbake
# POKY_BBLAYERS_CONF_VERSION is increased each time build/conf/bblayers.conf
# changes incompatibly
POKY_BBLAYERS_CONF_VERSION = "2"

BBPATH = "${TOPDIR}"
BBFILES ?= ""

BBLAYERS ?= " \
  BASE_PATH/poky/meta \
  BASE_PATH/poky/meta-poky \
  BASE_PATH/poky/meta-yocto-bsp \
  BASE_PATH/poky/meta-openembedded/meta-oe \
  BASE_PATH/poky/meta-openembedded/meta-networking \
  BASE_PATH/poky/meta-openembedded/meta-multimedia \
  BASE_PATH/poky/meta-openembedded/meta-python \
  BASE_PATH/poky/meta-raspberrypi \
  BASE_PATH/poky/meta-qt5 \
  BASE_PATH/myke/meta-myrpi \
"
```

## conf/distro/myke.conf
```bitbake
# Distro Layer configuration
# include and overwrite default poky distro
include conf/distro/poky.conf
DISTRO = "myke"
DISTRO_NAME = "myOS-Linux"
DISTRO_VERSION = "0.1.3"
DISTRO_CODENAME = "Dawn"
MAINTAINER = "info@myke.com"

TARGET_VENDOR = "-myke"

# Override these in poky based distros
PREFERRED_VERSION_linux-raspberrypi = "4.14.%"
MYKE_DEFAULT_DISTRO_FEATURES = "ext2 opengl usbhost systemd"
VIRTUAL-RUNTIME_init_manager = "systemd"
MYKE_CONNECTIVITY_FEATURES = "bluez5 bluetooth wifi"

DISTRO_FEATURES = "${MYKE_DEFAULT_DISTRO_FEATURES} ${DISTRO_FEATURES_LIBC} ${MYKE_CONNECTIVITY_FEATURES} "
PACKAGE_CLASSES = "package_ipk"
#IMAGE_CLASSES += "sdcard_image-myrpi"
#IMAGE_FSTYPES ?= "rpi-sdimg"

#DISTRO_FEATURES_BACKFILL_CONSIDERED += " pulseaudio"
DISTRO_FEATURES_BACKFILL_CONSIDERED = "sysvinit"

RPI_USE_U_BOOT ?= "1"
#KERNEL_IMAGETYPE ?= "uImage"

DISABLE_SPLASH = "1"
DISABLE_OVERSCAN = "1"
DISABLE_RPI_BOOT_LOGO = "1"

#WAVESHARE_1024X600_C_2_1 = "1"
```

## conf/layer.conf
```bitbake
# We have a conf and classes directory, append to BBPATH
BBPATH .= ":${LAYERDIR}"

# We have a recipes directory, add to BBFILES
BBFILES += "${LAYERDIR}/recipes*/*/*.bb ${LAYERDIR}/recipes*/*/*.bbappend ${LAYERDIR}/images/*.bb "

BBFILE_COLLECTIONS += "meta-myrpi"
BBFILE_PATTERN_meta-myrpi := "^${LAYERDIR}/"
BBFILE_PRIORITY_meta-myrpi = "10"

LAYERSERIES_COMPAT_meta-myrpi = "thud"
```
